## mcu/tests/scope/testcase.yaml
```yaml
# Copyright (c) 2026 Jim Wyatt
# SPDX-License-Identifier: MIT
tests:
  unoq.scope:
    platform_allow:
      - native_sim/native/64
      - arduino_uno_q
    tags: unoq
```

## mcu/tests/spi_proto/testcase.yaml
```yaml
# Copyright (c) 2026 Jim Wyatt
# SPDX-License-Identifier: MIT
tests:
  unoq.spi_proto:
    platform_allow:
      - native_sim/native/64
      - arduino_uno_q
    tags: unoq
```
